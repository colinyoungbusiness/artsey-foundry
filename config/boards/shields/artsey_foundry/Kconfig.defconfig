## config/boards/shields/artsey_foundry/Kconfig.defconfig
```kconfig
if SHIELD_ARTSEY_FOUNDRY

# Name must be less than 16 characters long!
config ZMK_KEYBOARD_NAME
    default "Artsey Foundry"

endif

# XTAL setup
CONFIG_SOC_ATMEL_SAMD_XOSC32K=y
CONFIG_SOC_ATMEL_SAMD_XOSC32K_AS_MAIN=y

# Bootloader Setup
CONFIG_BUILD_OUTPUT_UF2=y
CONFIG_BOOTLOADER_BOSSA=y
CONFIG_BOOTLOADER_BOSSA_ADAFRUIT_UF2=y

# ZMK USB Transport
CONFIG_ZMK_USB=y
```

## config/boards/shields/artsey_foundry/Kconfig.shield
```kconfig
# No whitespace after the comma or in your keyboard name!
config SHIELD_ARTSEY_FOUNDRY
    def_bool $(shields_list_contains,artsey_foundry)

# Copyright (c) 2026 Pete Johanson
# SPDX-License-Identifier: MIT
```
