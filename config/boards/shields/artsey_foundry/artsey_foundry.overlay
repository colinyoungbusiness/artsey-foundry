/ {

    kscan: kscan {
        compatible = "zmk,kscan-gpio-direct";

        input-gpios = 
            <&xiao_d 0 (GPIO_ACTIVE_LOW | GPIO_PULL_UP)>,
            <&xiao_d 1 (GPIO_ACTIVE_LOW | GPIO_PULL_UP)>,
            <&xiao_d 2 (GPIO_ACTIVE_LOW | GPIO_PULL_UP)>,
            <&xiao_d 3 (GPIO_ACTIVE_LOW | GPIO_PULL_UP)>,
            <&xiao_d 4 (GPIO_ACTIVE_LOW | GPIO_PULL_UP)>,
            <&xiao_d 10 (GPIO_ACTIVE_LOW | GPIO_PULL_UP)>,
            <&xiao_d 9 (GPIO_ACTIVE_LOW | GPIO_PULL_UP)>,
            <&xiao_d 8 (GPIO_ACTIVE_LOW | GPIO_PULL_UP)>;
    };

    chosen {
        zmk,kscan = &kscan;
    };
};